/**
 * @cliArgs --device "MSPM0G350X" --part "Default" --package "LQFP-64(PM)" --product "mspm0_sdk@2.02.00.05"
 * @versions {"tool":"1.21.0+3721"}
 */

/**
 * Import the modules used in this configuration.
 */
const DAC12   = scripting.addModule("/ti/driverlib/DAC12");
const MATHACL = scripting.addModule("/ti/driverlib/MATHACL");
const SYSCTL  = scripting.addModule("/ti/driverlib/SYSCTL");

/**
 * Write custom configuration values to the imported modules.
 */
const gate8  = system.clockTree["MFPCLKGATE"];
gate8.enable = true;

DAC12.dacConfigureDMA                = true;
DAC12.dacFIFOEn                      = true;
DAC12.dacFIFOThresh                  = "TWO_QTRS_EMPTY";
DAC12.dacEnabledInterrupts           = ["DMA_DONE"];
DAC12.dacOutputPinEn                 = true;
DAC12.dacAmplifier                   = "ON";
DAC12.dacSampleTimerRate             = "1M";
DAC12.dacRepresentation              = "TWOS_COMPLEMENT";
DAC12.DMA_CHANNEL.$name              = "DMA_CH0";
DAC12.DMA_CHANNEL.transferMode       = "FULL_CH_REPEAT_SINGLE";
DAC12.DMA_CHANNEL.addressMode        = "b2f";
DAC12.DMA_CHANNEL.srcLength          = "HALF_WORD";
DAC12.DMA_CHANNEL.dstLength          = "HALF_WORD";
DAC12.DMA_CHANNEL.peripheral.$assign = "DMA_CH0";
DAC12.OutPinConfig.$name             = "ti_driverlib_gpio_GPIOPinGeneric0";

const Board = scripting.addModule("/ti/driverlib/Board", {}, false);

SYSCTL.MFPCLKEn              = true;
SYSCTL.forceDefaultClkConfig = true;
SYSCTL.clockTreeEn           = true;

/**
 * Pinmux solution for unlocked pins/peripherals. This ensures that minor changes to the automatic solver in a future
 * version of the tool will not impact the pinmux you originally saw.  These lines can be completely deleted in order to
 * re-solve from scratch.
 */
DAC12.peripheral.$suggestSolution          = "DAC0";
DAC12.peripheral.OutPin.$suggestSolution   = "PA15";
Board.peripheral.$suggestSolution          = "DEBUGSS";
Board.peripheral.swclkPin.$suggestSolution = "PA20";
Board.peripheral.swdioPin.$suggestSolution = "PA19";
